#pragma once

#include "coredump_hash.hpp"
#include <cstring>
#include <new>
#include <vector>

// Compiled by the existing integration harness against its exact pinned real PSA
// library, never test/coredump_stubs. These are checksum-only synthetic bodies,
// not valid ELF dumps or firmware/ABI acceptance. Digests are independent Python
// hashlib SHA256 known answers for the explicitly generated bytes below.
template <class Check>
void check_coredump_hash_vectors(Check check) {
    const char* hashes[] = {
        "52e24e3f99b7af3a84bdb2f9fff5dd04e1d1b0b819ec3a0bcd3869a3514985b7",
        "c1c5b7c14047c60c929bcd08af79c68ad56ff31c833cbf922d273f699244440a"
    };
    unsigned fixture = 0;
    for (uint32_t length : {96U, 768U}) {
        std::vector<uint8_t> image(length, 0x5a);
        for (unsigned i = 0; i < 4; ++i) {
            image[i] = static_cast<uint8_t>(length >> (i * 8));
            image[4 + i] = static_cast<uint8_t>(0x00090104U >> (i * 8));
            image[8 + i] = 0;
        }
        for (unsigned i = 0; i < 32; ++i) {
            image[length - 32 + i] = static_cast<uint8_t>(
                tk::dump_hex(hashes[fixture][2 * i]) * 16 + tk::dump_hex(hashes[fixture][2 * i + 1]));
        }
        ++fixture;
        unsigned last_reads = 0;
        auto run = [&](const std::vector<uint8_t>& bytes, unsigned fail_at = 0, unsigned throw_at = 0) {
            unsigned reads = 0;
            auto read = [&](uint32_t offset, void* destination, uint32_t size) {
                ++reads;
                const bool bounded = offset <= bytes.size() && size <= bytes.size() - offset && size <= 256;
                check(bounded, "coredump real-PSA callback stays bounded");
                if (!bounded || reads == fail_at) return false;
                if (reads == throw_at) throw std::bad_alloc();
                std::memcpy(destination, bytes.data() + offset, size);
                return true;
            };
            tk::CoredumpInput<decltype(read)> input(read, static_cast<uint32_t>(bytes.size()));
            const auto outer = input.admit();
            bool result = false, caught = false;
            try { result = tk::verify_coredump_checksum(input, outer); }
            catch (const std::bad_alloc&) { caught = true; }
            check(caught == (throw_at != 0), "coredump real-PSA exceptional read propagates to owner");
            last_reads = reads;
            return result;
        };
        check(run(image), "coredump real-PSA independent known answer passes");
        const unsigned normal_reads = last_reads;
        auto changed = image;
        changed[20] ^= 1;
        check(!run(changed), "coredump real-PSA changed body rejected");
        changed = image;
        changed.back() ^= 1;
        check(!run(changed), "coredump real-PSA changed trailer rejected");
        for (unsigned at = 2; at <= normal_reads; ++at) {
            check(!run(image, at), "coredump real-PSA read failure rejected");
            check(run(image), "coredump real-PSA fresh operation works after failed read");
            check(!run(image, 0, at), "coredump real-PSA thrown read rejected");
            check(run(image), "coredump real-PSA fresh operation works after exceptional abort");
        }
    }
}
