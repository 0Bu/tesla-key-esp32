// On-device ST7735 status display for the LilyGo T-Dongle-C5 and T-Dongle-S3 (both a 0.96" IPS
// 80x160 panel, same ST7735 init/gamma/INVON). Drivable LANDSCAPE (160x80) OR PORTRAIT (80x160)
// — the BOOT button rotates 90° per press through 4 orientations (draw_landscape / draw_portrait;
// the choice persists in NVS tesla_cfg/disp_rot). Renders the charge/connection state — see
// display.hpp for the design contract; the layout mirrors tools/display_sim.py (the pixel-exact
// renderer) 1:1. Compiled only when CONFIG_TESLA_DISPLAY_ENABLED (set for esp32c5 AND esp32s3 in
// their sdkconfig.defaults.*); a no-op stub on the other targets. The panel pins come from
// Kconfig (per-board sdkconfig.defaults.*); the C5-vs-S3 deltas (SPI clock, BOOT-button GPIO) are
// selected by CONFIG_IDF_TARGET_* in display_start(). The single esp32s3 image serves both the
// T-Dongle-S3 and a generic ESP32-S3: display_start() auto-detects the dongle and stays a
// complete no-op on a generic board.

#include "display.hpp"
#include "sdkconfig.h"

#if CONFIG_TESLA_DISPLAY_ENABLED

#include <cstdint>
#include <cstring>
#include <cstdio>
#include <cmath>
#include <exception>
#include <string>

#include "freertos/FreeRTOS.h"
#include "freertos/task.h"
#include "driver/spi_master.h"
#include "task_config.hpp"
#include "driver/gpio.h"
#include "esp_heap_caps.h"
#include "esp_wifi.h"
#include "esp_log.h"
#include "esp_rom_sys.h"   // esp_rom_delay_us for the T-Dongle-S3 board probe
#include "nvs.h"           // persist the BOOT-button rotation index across reboots

#include "vehicle_ctrl.hpp"
#include "logic/ui_state.hpp"        // tk::UiSnapshot — the shared status-indicator input
#include "logic/display_model.hpp"   // tk::display::compose() — the pure "what to show" decision
#include "display_font.h"   // generated by tools/display_sim.py — font + BT/BOLT bitmaps

static const char* TAG = "display";

// Defined in main.cpp — true only while the STA holds an IP. The display task is
// created (display_start) BEFORE wifi_connect() and at higher priority than
// app_main, so without this guard it would call esp_wifi_sta_get_ap_info() while
// esp_wifi is still initialising / churning through association — a concurrent read
// of the half-built AP record faults (LoadProhibited, EXCVADDR=0x1). Not connected →
// the centre WiFi-search animation is shown instead (the correct state anyway).
bool wifi_is_connected();

// ─── panel geometry & fixed T-Dongle wiring ──────────────────────────────────
// The SPI pins + backlight polarity are fixed per board (set once in display_start); the
// MADCTL and RAM offsets are swapped at runtime by the BOOT-button rotation (apply_rotation).
struct DisplayConfig {
    int     mosi, sck, cs, dc, rst, bl;   // SPI + control GPIOs
    bool    bl_active_low;                // drive backlight LOW to light it
    int     x_off, y_off;                 // ST7735 RAM offsets (col/row start for the current rotation)
    uint8_t madctl;                       // memory-access / rotation byte
};

// Current framebuffer geometry — swapped by the BOOT-button rotation between landscape
// (160x80) and portrait (80x160). Both are 160*80 = 80*160 = 12800 px, so rotating the panel
// never reallocates the framebuffer; only the stride (W) and the flush bounds (W,H) change.
static int W = 160;
static int H = 80;
static constexpr int FB_PX = 160 * 80;            // fixed framebuffer capacity (either orientation)

// The 4 BOOT-rotation orientations (90° per press, cycled in array order). Two landscape + two
// portrait; each pair's 180° variant is a pure MADCTL bit-flip of the SAME framebuffer. The
// 0.96" panel's visible window is centered in the ST7735 RAM (col 26+80+26 = 132, row
// 1+160+1 = 162), so the offsets are symmetric: they only SWAP between portrait (26,1) and
// landscape (1,26) and stay identical across a 180° flip. Landscape MADCTL 0xA8 + offsets (1,26)
// are HW-verified on the C5/S3; the portrait MADCTL/offsets follow the standard ST7735 rotation
// set. Adjacent indices are 90° apart, so ++index rotates one way and --index the other.
struct RotDef { uint8_t madctl; int w, h, x_off, y_off; bool portrait; };
static constexpr RotDef ROTS[4] = {
    { 0xC8,  80, 160, 26,  1, true  },   // 0 · portrait
    { 0xA8, 160,  80,  1, 26, false },   // 1 · landscape (power-on default)
    { 0x08,  80, 160, 26,  1, true  },   // 2 · portrait, 180°
    { 0x68, 160,  80,  1, 26, false },   // 3 · landscape, 180°
};
static int s_rot = 1;                             // current rotation index (default: landscape)

static DisplayConfig s_cfg{};                     // set once in display_start()
static inline int BL_ON() { return s_cfg.bl_active_low ? 0 : 1; }

// ─── colours (RGB565, natural order; byte-swapped at flush) — DARK theme ──────
static inline uint16_t rgb565(uint8_t r, uint8_t g, uint8_t b) {
    return (uint16_t)(((r & 0xF8) << 8) | ((g & 0xFC) << 3) | (b >> 3));
}
static const uint16_t C_BG      = rgb565( 13,  16,  22);   // near-black screen bg
static const uint16_t C_PANEL   = rgb565( 26,  32,  45);   // battery interior / empty
static const uint16_t C_BORDER  = rgb565(236, 238, 242);   // battery shell + terminal
static const uint16_t C_INK     = rgb565(240, 242, 245);   // primary text
static const uint16_t C_GREY    = rgb565(128, 138, 152);   // muted / disconnected
static const uint16_t C_DIV     = rgb565( 38,  46,  60);   // header divider
static const uint16_t C_BAR_ON  = rgb565( 74, 175,  80);   // lit signal bar (green)
static const uint16_t C_BAR_OFF = rgb565( 40,  50,  64);   // unlit signal bar
static const uint16_t C_BOLT    = rgb565(255, 235, 120);   // charging bolt (yellow)
// BLE "searching" bars sweep from a deep/dark green (resting) to a bright light-green
// (highlight), with a soft gradient around the peak — high contrast so the wave is obvious.
static const int C_BLE_LIGHT_RGB[3] = {170, 232, 158};
static const int C_BLE_GREEN_RGB[3] = { 16,  78,  36};

// The SoC gradient (red→amber→green), the RSSI→bars thresholds and the SSID-scroll
// ping-pong now live in the pure, host-tested presenter (logic/display_model.hpp), which
// hands this renderer the finished fill colour / bar counts / scroll offset in a Model.
// lerp8 stays here: it is also the colour interpolator for the BLE search sweep below.
static inline int lerp8(int a, int b, float t) { return a + (int)lroundf((b - a) * t); }

// ─── state ────────────────────────────────────────────────────────────────────
static spi_device_handle_t s_spi = nullptr;
static uint16_t*           s_fb  = nullptr;   // W*H framebuffer (PSRAM if present)

// ─── low-level SPI ──────────────────────────────────────────────────────────--
static void dc(int level) { gpio_set_level((gpio_num_t)s_cfg.dc, level); }

static void spi_tx(const uint8_t* data, size_t len) {
    if (!len) return;
    spi_transaction_t t = {};
    t.length    = len * 8;
    t.tx_buffer = data;
    spi_device_polling_transmit(s_spi, &t);
}
static void wr_cmd(uint8_t c)  { dc(0); spi_tx(&c, 1); }
static void wr_data(uint8_t d) { dc(1); spi_tx(&d, 1); }
static void wr_data_n(const uint8_t* d, size_t n) { dc(1); spi_tx(d, n); }

static void set_window(int x0, int y0, int x1, int y1) {
    uint8_t cax[4] = { 0, (uint8_t)(x0 + s_cfg.x_off), 0, (uint8_t)(x1 + s_cfg.x_off) };
    uint8_t ray[4] = { 0, (uint8_t)(y0 + s_cfg.y_off), 0, (uint8_t)(y1 + s_cfg.y_off) };
    wr_cmd(0x2A); wr_data_n(cax, 4);   // CASET
    wr_cmd(0x2B); wr_data_n(ray, 4);   // RASET
    wr_cmd(0x2C);                      // RAMWR
}

// Init sequence (commands, delays, gamma/power tables, INVON, COLMOD 0x05) is the
// one LilyGo ships for this panel — Xinyuan-LilyGO/T-Dongle-C5 st7735.cpp; the
// T-Dongle-S3 uses the identical ST7735 panel. MADCTL is s_cfg.madctl, the current
// BOOT-rotation orientation (set from ROTS before init, re-sent by apply_rotation on a tap).
static void panel_init() {
    // Hardware reset — match LilyGo's begin(): idle HIGH, 100 ms LOW pulse, 120 ms HIGH.
    gpio_set_level((gpio_num_t)s_cfg.rst, 1); vTaskDelay(pdMS_TO_TICKS(100));
    gpio_set_level((gpio_num_t)s_cfg.rst, 0); vTaskDelay(pdMS_TO_TICKS(100));
    gpio_set_level((gpio_num_t)s_cfg.rst, 1); vTaskDelay(pdMS_TO_TICKS(120));

    wr_cmd(0x01); vTaskDelay(pdMS_TO_TICKS(150));            // SWRESET
    wr_cmd(0x11); vTaskDelay(pdMS_TO_TICKS(255));            // SLPOUT

    uint8_t frm[3]  = { 0x01, 0x2C, 0x2D };
    wr_cmd(0xB1); wr_data_n(frm, 3);                        // FRMCTR1
    wr_cmd(0xB2); wr_data_n(frm, 3);                        // FRMCTR2
    uint8_t frm3[6] = { 0x01,0x2C,0x2D,0x01,0x2C,0x2D };
    wr_cmd(0xB3); wr_data_n(frm3, 6);                      // FRMCTR3
    wr_cmd(0xB4); wr_data(0x07);                           // INVCTR

    uint8_t pw1[3] = { 0xA2, 0x02, 0x84 };
    wr_cmd(0xC0); wr_data_n(pw1, 3);                       // PWCTR1
    wr_cmd(0xC1); wr_data(0xC5);                           // PWCTR2
    uint8_t pw3[2] = { 0x0A, 0x00 };
    wr_cmd(0xC2); wr_data_n(pw3, 2);                       // PWCTR3
    uint8_t pw4[2] = { 0x8A, 0x2A };
    wr_cmd(0xC3); wr_data_n(pw4, 2);                       // PWCTR4
    uint8_t pw5[2] = { 0x8A, 0xEE };
    wr_cmd(0xC4); wr_data_n(pw5, 2);                       // PWCTR5
    wr_cmd(0xC5); wr_data(0x0E);                           // VMCTR1

    wr_cmd(0x21);                                          // INVON (0.96" IPS)
    wr_cmd(0x36); wr_data(s_cfg.madctl);                  // MADCTL (current BOOT-rotation orientation)
    wr_cmd(0x3A); wr_data(0x05);                           // COLMOD: 16-bit/pixel

    uint8_t gp[16] = { 0x02,0x1c,0x07,0x12,0x37,0x32,0x29,0x2d,
                       0x29,0x25,0x2B,0x39,0x00,0x01,0x03,0x10 };
    wr_cmd(0xE0); wr_data_n(gp, 16);                       // GMCTRP1
    uint8_t gn[16] = { 0x03,0x1d,0x07,0x06,0x2E,0x2C,0x29,0x2D,
                       0x2E,0x2E,0x37,0x3F,0x00,0x00,0x02,0x10 };
    wr_cmd(0xE1); wr_data_n(gn, 16);                       // GMCTRN1

    wr_cmd(0x13); vTaskDelay(pdMS_TO_TICKS(10));            // NORON
    wr_cmd(0x29); vTaskDelay(pdMS_TO_TICKS(100));           // DISPON
}

// Push the whole framebuffer one row at a time through a DMA-capable bounce buffer
// — keeps the framebuffer in PSRAM (where present) and never DMAs from it.
static void flush() {
    static uint8_t line[160 * 2];              // sized for the wider (landscape) orientation
    for (int y = 0; y < H; ++y) {
        const uint16_t* src = &s_fb[y * W];
        for (int x = 0; x < W; ++x) {
            line[x * 2]     = src[x] >> 8;     // hi byte first (big-endian panel)
            line[x * 2 + 1] = src[x] & 0xFF;
        }
        set_window(0, y, W - 1, y);
        wr_data_n(line, W * 2);
    }
}

// ─── framebuffer drawing ──────────────────────────────────────────────────────
static inline void put(int x, int y, uint16_t c) {
    if ((unsigned)x < (unsigned)W && (unsigned)y < (unsigned)H) s_fb[y * W + x] = c;
}
static void fill(uint16_t c) { for (int i = 0; i < W * H; ++i) s_fb[i] = c; }
static void rect(int x0, int y0, int x1, int y1, uint16_t c) {
    for (int y = y0; y < y1; ++y) for (int x = x0; x < x1; ++x) put(x, y, c);
}
// Hollow border of thickness t with the 4 hard corners nibbled to bg (softer look).
static void border(int x0, int y0, int x1, int y1, int t, uint16_t c) {
    rect(x0, y0, x1, y0 + t, c);
    rect(x0, y1 - t, x1, y1, c);
    rect(x0, y0, x0 + t, y1, c);
    rect(x1 - t, y0, x1, y1, c);
    put(x0, y0, C_BG); put(x1 - 1, y0, C_BG);
    put(x0, y1 - 1, C_BG); put(x1 - 1, y1 - 1, C_BG);
}

static int text_w(const char* s, int scale) { return (int)strlen(s) * 6 * scale; }

static void draw_char(int x, int y, char ch, uint16_t col, int scale) {
    if (ch < 0x20 || ch > 0x7E) ch = ' ';   // outside printable ASCII → blank
    const uint8_t* g = DISPLAY_FONT5X7[ch - 0x20];
    for (int c = 0; c < 5; ++c) {
        uint8_t colbits = g[c];
        for (int r = 0; r < 7; ++r) {
            if (colbits & (1 << r)) {
                for (int dy = 0; dy < scale; ++dy)
                    for (int dx = 0; dx < scale; ++dx)
                        put(x + c * scale + dx, y + r * scale + dy, col);
            }
        }
    }
}
static int draw_text(int x, int y, const char* s, uint16_t col, int scale) {
    for (; *s; ++s) { draw_char(x, y, *s, col, scale); x += 6 * scale; }
    return x;
}
// White-on-anything text: 4-neighbour outline in oc, then the glyph in col.
static void draw_text_outline(int x, int y, const char* s, uint16_t col, int scale, uint16_t oc) {
    draw_text(x - 1, y, s, oc, scale); draw_text(x + 1, y, s, oc, scale);
    draw_text(x, y - 1, s, oc, scale); draw_text(x, y + 1, s, oc, scale);
    draw_text(x, y, s, col, scale);
}
// Like draw_text but only sets pixels with cx0 <= px < cx1 (the SSID scroll window).
static void draw_text_clip(int x, int y, const char* s, uint16_t col, int scale,
                           int cx0, int cx1) {
    for (; *s; ++s) {
        char ch = (*s >= 0x20 && *s <= 0x7E) ? *s : ' ';
        const uint8_t* g = DISPLAY_FONT5X7[ch - 0x20];
        for (int c = 0; c < 5; ++c) {
            uint8_t colbits = g[c];
            for (int r = 0; r < 7; ++r) {
                if (colbits & (1 << r)) {
                    for (int dy = 0; dy < scale; ++dy)
                        for (int dx = 0; dx < scale; ++dx) {
                            int px = x + c * scale + dx;
                            if (px >= cx0 && px < cx1) put(px, y + r * scale + dy, col);
                        }
                }
            }
        }
        x += 6 * scale;
    }
}

// Row-major bitmap: bit (w-1-c) of rows[r] = pixel (col c, row r). Template so the
// 8-bit BT glyph and the 16-bit bolt share one routine.
template <typename T>
static void blit_rows(int x, int y, const T* rows, int w, int h, int scale, uint16_t col) {
    for (int r = 0; r < h; ++r) {
        T bits = rows[r];
        for (int c = 0; c < w; ++c) {
            if (bits & (1u << (w - 1 - c))) {
                for (int dy = 0; dy < scale; ++dy)
                    for (int dx = 0; dx < scale; ++dx)
                        put(x + c * scale + dx, y + r * scale + dy, col);
            }
        }
    }
}
template <typename T>
static void blit_rows_outline(int x, int y, const T* rows, int w, int h, int scale,
                              uint16_t col, uint16_t oc) {
    static const int N[8][2] = {{-1,0},{1,0},{0,-1},{0,1},{-1,-1},{1,1},{-1,1},{1,-1}};
    for (int i = 0; i < 8; ++i) blit_rows(x + N[i][0], y + N[i][1], rows, w, h, scale, oc);
    blit_rows(x, y, rows, w, h, scale, col);
}

// 4 ascending bars, bottom-aligned at y+14; lit in `on`, unlit dark.
static void signal_bars(int x, int y, int level, uint16_t on) {
    for (int i = 0; i < 4; ++i) {
        int bh = 4 + i * 3;
        uint16_t col = (i < level) ? on : C_BAR_OFF;
        rect(x + i * 4, y + (14 - bh), x + i * 4 + 3, y + 14, col);
    }
}

// "Searching for a connection" animation, drawn where the battery would be (no
// battery while disconnected): a link label on the left — a Bluetooth glyph for BLE,
// or the word "WiFi" for WiFi — and a compact, right-flush cluster of 5 ascending
// bars whose bright light-green highlight sweeps across the dark-green resting
// bars to read as "scanning" — the bars near the peak are lit half-bright so the
// wave has a soft gradient, not a single hard bar. The swept bars are identical for
// WiFi and BLE; only the label differs.
// Mirrors draw_search_bars()/draw_searching_* in tools/display_sim.py.
static constexpr int   SRCH_N = 5, SRCH_BW = 10, SRCH_GAP = 6, SRCH_X0 = 80, SRCH_BASE = 70;  // compact, right-flush
static constexpr int   SRCH_ICON_SCALE = 3;
static constexpr int   SRCH_BT_X = 24, SRCH_BT_Y = 36;      // Bluetooth glyph, off the left edge
static constexpr int   SRCH_STEPS = 3;                       // animation sub-frames per bar
static constexpr float SRCH_FALLOFF = 1.5f;                  // highlight width, in bars
static constexpr int   SRCH_HALF = (SRCH_N - 1) * SRCH_STEPS;   // one direction (small↔large)
static constexpr int   SRCH_CYCLE = 2 * SRCH_HALF;           // full ping-pong period

// The swept bars are identical for WiFi and BLE searches; the highlight ping-pongs
// (a triangle wave) out and back across them — not a one-way scan.
static void draw_search_bars(int frame) {
    int p = frame % SRCH_CYCLE;
    float hp = (p <= SRCH_HALF ? p : (SRCH_CYCLE - p)) / (float)SRCH_STEPS;
    for (int i = 0; i < SRCH_N; ++i) {
        int   h = 12 + i * 7;
        float d = fabsf(i - hp);
        float t = d >= SRCH_FALLOFF ? 0.0f : (1.0f - d / SRCH_FALLOFF);
        uint16_t col = rgb565(lerp8(C_BLE_GREEN_RGB[0], C_BLE_LIGHT_RGB[0], t),
                              lerp8(C_BLE_GREEN_RGB[1], C_BLE_LIGHT_RGB[1], t),
                              lerp8(C_BLE_GREEN_RGB[2], C_BLE_LIGHT_RGB[2], t));
        int x = SRCH_X0 + i * (SRCH_BW + SRCH_GAP);
        rect(x, SRCH_BASE - h, x + SRCH_BW, SRCH_BASE, col);
    }
}
// BLE search: a Bluetooth glyph left of the bars.
static void draw_searching_icon(int frame, const uint8_t* icon, int iw, int ih, int ix, int iy) {
    blit_rows(ix, iy, icon, iw, ih, SRCH_ICON_SCALE, C_INK);
    draw_search_bars(frame);
}
// WiFi search: the word "WiFi" left of the bars (clearer than a glyph here).
static void draw_searching_text(int frame, const char* s, int scale, int x, int y) {
    draw_text(x, y, s, C_INK, scale);
    draw_search_bars(frame);
}

// Shown (instead of the search bars) once a BLE link is up but pairing isn't done:
// big "Pairing" with an animated 0–3 dot ellipsis (fixed left so it doesn't jiggle).
static void draw_pairing(int frame) {
    int nd = (frame / 4) % 4;
    char buf[12];
    snprintf(buf, sizeof(buf), "Pairing%.*s", nd, "...");
    draw_text((W - text_w("Pairing...", 2)) / 2, 42, buf, C_INK, 2);
}

// (The over-long-SSID marquee offset — ping-pong pause/scroll-out/pause/scroll-back — is
// now computed by the pure presenter; this renderer receives the finished offset in Model.)

// ─── portrait (80x160) search/pairing heroes ───────────────────────────────────
// Same colours + ping-pong animation timing as landscape, but the icon/label sits ABOVE a
// centered, taller bar cluster to use the portrait height. Mirrors tools/display_sim.py.
static constexpr int PSB_N = 5, PSB_BW = 8, PSB_GAP = 5, PSB_BASE = 138;   // 5 bars, centered
static void draw_portrait_search_bars(int frame) {
    const int total = PSB_N * PSB_BW + (PSB_N - 1) * PSB_GAP;   // 60 px
    const int x0 = (W - total) / 2;
    int p = frame % SRCH_CYCLE;
    float hp = (p <= SRCH_HALF ? p : (SRCH_CYCLE - p)) / (float)SRCH_STEPS;
    for (int i = 0; i < PSB_N; ++i) {
        int   h = 14 + i * 9;
        float d = fabsf(i - hp);
        float t = d >= SRCH_FALLOFF ? 0.0f : (1.0f - d / SRCH_FALLOFF);
        uint16_t col = rgb565(lerp8(C_BLE_GREEN_RGB[0], C_BLE_LIGHT_RGB[0], t),
                              lerp8(C_BLE_GREEN_RGB[1], C_BLE_LIGHT_RGB[1], t),
                              lerp8(C_BLE_GREEN_RGB[2], C_BLE_LIGHT_RGB[2], t));
        int x = x0 + i * (PSB_BW + PSB_GAP);
        rect(x, PSB_BASE - h, x + PSB_BW, PSB_BASE, col);
    }
}
// wifi=true → the word "WiFi" (scale 2); else the Bluetooth glyph (scale 3), both centered.
static void draw_portrait_search(int frame, bool wifi) {
    if (wifi) draw_text((W - text_w("WiFi", 2)) / 2, 52, "WiFi", C_INK, 2);
    else      blit_rows((W - DISPLAY_BT_W * 3) / 2, 46, DISPLAY_BT_ROWS,
                        DISPLAY_BT_W, DISPLAY_BT_H, 3, C_INK);
    draw_portrait_search_bars(frame);
}
static void draw_portrait_pairing(int frame) {
    int nd = (frame / 4) % 4;
    char buf[12];
    snprintf(buf, sizeof(buf), "Pairing%.*s", nd, "...");
    blit_rows((W - DISPLAY_BT_W * 3) / 2, 50, DISPLAY_BT_ROWS, DISPLAY_BT_W, DISPLAY_BT_H, 3, C_INK);
    draw_text((W - text_w("Pairing...", 1)) / 2, 96, buf, C_INK, 1);   // scale 1: scale 2 is too wide for 80 px
}

// ─── landscape (160x80) layout — the original, HW-verified design ───────────────
static bool draw_landscape(const tk::display::Model& m, const tk::UiSnapshot& s, int tick) {
    // header: WiFi bars + SSID (scale 2); hidden while WiFi is the active search hero. An
    // over-long SSID scrolls (clipped marquee) at the presenter-computed offset.
    if (m.show_wifi) {
        signal_bars(4, 4, m.wifi_bars, C_BAR_ON);
        if (!m.ssid_scrolling) {
            draw_text(28, 4, s.ssid, C_INK, 2);
        } else {
            draw_text_clip(28 - m.ssid_scroll_off, 4, s.ssid, C_INK, 2, 28, 28 + m.ssid_avail);
        }
    }
    // header: BLE bars + BT glyph; hidden while BLE is the active search hero.
    if (m.show_ble) {
        int bx = 158 - 16;                    // 4 bars * 4px
        signal_bars(bx, 4, m.ble_bars, C_BAR_ON);
        blit_rows(bx - 13, 1, DISPLAY_BT_ROWS, DISPLAY_BT_W, DISPLAY_BT_H, 2,
                  m.ble_glyph_on ? C_INK : C_GREY);   // BT glyph, scale 2
    }

    rect(3, 22, W - 3, 23, C_DIV);            // divider under the (taller) header

    // ── centre hero: WiFi search > pairing > BLE search > battery ────────────
    switch (m.hero) {
        case tk::display::Hero::WifiSearch:
            draw_searching_text(tick, "WiFi", 2, 14, 42);   // "WiFi" word, not a glyph
            return true;
        case tk::display::Hero::Pairing:
            draw_pairing(tick);
            return true;
        case tk::display::Hero::BleSearch:
            draw_searching_icon(tick, DISPLAY_BT_ROWS, DISPLAY_BT_W, DISPLAY_BT_H,
                                SRCH_BT_X, SRCH_BT_Y);
            return true;
        case tk::display::Hero::Battery:
            break;                            // fall through to the battery body below
    }

    // ── battery shell (horizontal, fills left→right) ─────────────────────────
    const int bx0 = 6, by0 = 24, bx1 = 146, by1 = 74;
    rect(bx0 + 2, by0 + 2, bx1 - 2, by1 - 2, C_PANEL);   // interior
    border(bx0, by0, bx1, by1, 3, C_BORDER);             // shell
    rect(bx1, 40, bx1 + 6, 58, C_BORDER);                // + terminal nub
    const int ix0 = bx0 + 3, iy0 = by0 + 3, ix1 = bx1 - 3, iy1 = by1 - 3;
    const int iw = ix1 - ix0;

    uint16_t fill_col = rgb565(m.fill_r, m.fill_g, m.fill_b);   // presenter already blended asleep-dim
    int fw = (int)lroundf(iw * m.soc / 100.0f);
    if (fw > 0) rect(ix0, iy0, ix0 + fw, iy1, fill_col);

    char num[8];
    snprintf(num, sizeof(num), "%d%%", m.soc);

    if (m.show_bolt) {                         // centred group: [bolt][gap][NN%]
        int bw = DISPLAY_BOLT_W * 2, gap = 6;
        int grp = bw + gap + text_w(num, 3);
        int gx = (W - grp) / 2;
        blit_rows_outline(gx, (H + 18 - DISPLAY_BOLT_H * 2) / 2 - 2,
                          DISPLAY_BOLT_ROWS, DISPLAY_BOLT_W, DISPLAY_BOLT_H, 2, C_BOLT, C_BG);
        draw_text_outline(gx + bw + gap, 41, num, C_INK, 3, C_BG);
    } else {
        draw_text_outline((W - text_w(num, 3)) / 2, 41, num,
                          m.asleep ? C_GREY : C_INK, 3, C_BG);
    }

    if (m.asleep)
        draw_text((W - text_w("ASLEEP", 1)) / 2, 64, "ASLEEP", C_GREY, 1);
    return m.animating;   // battery view: fast refresh only while the SSID marquee moves
}

// ─── portrait (80x160) layout — a VERTICAL battery, filling bottom→top ──────────
static bool draw_portrait(const tk::display::Model& m, const tk::UiSnapshot& s, int tick) {
    // header row 1: WiFi bars (left) | BT glyph + BLE bars (right); row 2: SSID; divider at y31.
    if (m.show_wifi) {
        signal_bars(4, 4, m.wifi_bars, C_BAR_ON);
        if (!m.ssid_scrolling) {                          // scale-1 SSID, centered when it fits
            draw_text((W - text_w(s.ssid, 1)) / 2, 21, s.ssid, C_INK, 1);
        } else {                                          // else clip-scroll it in its own row
            draw_text_clip(4 - m.ssid_scroll_off, 21, s.ssid, C_INK, 1, 4, 4 + m.ssid_avail);
        }
    }
    if (m.show_ble) {
        int bx = W - 4 - 16;                              // 4 bars * 4px, right-flush
        signal_bars(bx, 4, m.ble_bars, C_BAR_ON);
        blit_rows(bx - 12, 1, DISPLAY_BT_ROWS, DISPLAY_BT_W, DISPLAY_BT_H, 2,
                  m.ble_glyph_on ? C_INK : C_GREY);       // BT glyph, scale 2
    }
    rect(4, 31, W - 4, 32, C_DIV);                        // divider

    // ── centre hero: WiFi search > pairing > BLE search > battery ────────────
    switch (m.hero) {
        case tk::display::Hero::WifiSearch: draw_portrait_search(tick, /*wifi*/true);  return true;
        case tk::display::Hero::Pairing:    draw_portrait_pairing(tick);               return true;
        case tk::display::Hero::BleSearch:  draw_portrait_search(tick, /*wifi*/false); return true;
        case tk::display::Hero::Battery:    break;
    }

    // ── vertical battery: terminal nub on top, fill grows bottom→top ─────────
    rect(30, 34, 50, 40, C_BORDER);                       // terminal nub
    const int bx0 = 10, by0 = 40, bx1 = 70, by1 = 152;
    rect(bx0 + 2, by0 + 2, bx1 - 2, by1 - 2, C_PANEL);    // interior
    border(bx0, by0, bx1, by1, 3, C_BORDER);              // shell
    const int ix0 = bx0 + 3, iy0 = by0 + 3, ix1 = bx1 - 3, iy1 = by1 - 3;   // 13,43 .. 67,149
    const int ih = iy1 - iy0;

    uint16_t fill_col = rgb565(m.fill_r, m.fill_g, m.fill_b);   // presenter already blended asleep-dim
    int fh = (int)lroundf(ih * m.soc / 100.0f);
    if (fh > 0) rect(ix0, iy1 - fh, ix1, iy1, fill_col);  // bottom-anchored

    char num[8];
    snprintf(num, sizeof(num), "%d%%", m.soc);
    int nscale = (m.soc < 100) ? 3 : 2;                   // "100%" overflows 80 px at scale 3 → scale 2
    if (m.show_bolt) {                                    // bolt above, number below
        blit_rows_outline((W - DISPLAY_BOLT_W * 2) / 2, 60,
                          DISPLAY_BOLT_ROWS, DISPLAY_BOLT_W, DISPLAY_BOLT_H, 2, C_BOLT, C_BG);
        draw_text_outline((W - text_w(num, nscale)) / 2, 100, num, C_INK, nscale, C_BG);
    } else {
        draw_text_outline((W - text_w(num, nscale)) / 2, 92, num,
                          m.asleep ? C_GREY : C_INK, nscale, C_BG);
    }

    if (m.asleep)
        draw_text((W - text_w("ASLEEP", 1)) / 2, 132, "ASLEEP", C_GREY, 1);
    return m.animating;   // battery view: fast refresh only while the SSID marquee moves
}

// ─── render one frame from the presenter's Model (mirrors tools/display_sim.py) ────────
// Returns true when it drew something animated (a search/pairing hero, or a scrolling
// SSID) so the task keeps refreshing fast. `tick` is a monotonic frame counter;
// `paired` = VehicleController::has_session(), sampled by the task (it hits NVS, so it's
// not called every frame). All "what to show" decisions come from the pure, host-tested
// presenter (tk::display::compose) — this function only ASSEMBLES the snapshot and DRAWS,
// dispatching to the landscape or portrait layout for the current BOOT-rotation.
static bool render_frame(VehicleController& v, int tick, bool paired) {
    // ── assemble the UI snapshot at the presentation seam (see logic/ui_state.hpp) ──
    // Vehicle-owned fields arrive in one lock-guarded read; `paired` is the task's ≤1 Hz
    // sample; the WiFi fields come from esp_wifi, but only once the STA holds an IP — never
    // during init/association churn (see wifi_is_connected()): avoids the concurrent-read fault.
    tk::UiSnapshot s = v.ui_snapshot();
    s.paired = paired;
    wifi_ap_record_t ap = {};
    s.wifi_on = wifi_is_connected() && (esp_wifi_sta_get_ap_info(&ap) == ESP_OK);
    if (s.wifi_on) {
        s.wifi_rssi = ap.rssi;
        snprintf(s.ssid, sizeof(s.ssid), "%s", (const char*)ap.ssid);
    }

    // ── pure decision: what to show (priority ladder, colours, bars, scroll) ──
    const bool portrait = ROTS[s_rot].portrait;
    const tk::display::Orient orient = portrait ? tk::display::Orient::Portrait
                                                : tk::display::Orient::Landscape;
    const tk::display::Model m = tk::display::compose(s, (uint32_t)tick, orient);

    // ── render the Model in the current orientation ─────────────────────────
    fill(C_BG);
    return portrait ? draw_portrait(m, s, tick) : draw_landscape(m, s, tick);
}

// ─── refresh task ──────────────────────────────────────────────────────────--
// `tick` is monotonic so animations (search sweep, pairing dots) and the SSID
// marquee advance smoothly. When render_frame() reports nothing animating we idle at
// 1 Hz; while something animates (incl. a scrolling SSID) we refresh fast (~8 fps).
// ─── BOOT button: each tap rotates the panel 90° (persisted) ───────────────────
// The dongle's BOOT button (T-Dongle-C5: GPIO28, its only button; T-Dongle-S3: GPIO0) is a
// normal input after boot (external pull-up; pressed = LOW). Each press steps the rotation
// index (ROTS) by one, cycling landscape → portrait → landscape-180° → portrait-180° → …, so
// the user can stand the dongle up in any of the four orientations with taps. The chosen index
// is stored in NVS (tesla_cfg/disp_rot) so it survives reboots. The SPI clock also differs per
// board (both drive the same panel): LilyGo's tested C5 rate is 20 MHz, the S3 HW-verified at 40.
#if CONFIG_IDF_TARGET_ESP32C5
static constexpr int BOOT_BTN     = 28;                 // T-Dongle-C5: BOOT on GPIO28
static constexpr int SPI_CLOCK_HZ = 20 * 1000 * 1000;   // LilyGo's tested C5 rate (40 MHz over-spec → blank panel)
#else  // esp32s3 (T-Dongle-S3)
static constexpr int BOOT_BTN     = 0;                  // T-Dongle-S3: BOOT on GPIO0
static constexpr int SPI_CLOCK_HZ = 40 * 1000 * 1000;   // HW-verified on the T-Dongle-S3
#endif

// Load the saved rotation index (0..3). Migrates the pre-rotation NVS key `disp_flip` (a bool:
// the old 180° landscape flip) → the equivalent index: unflipped → 1 (landscape), flipped → 3.
static int load_disp_rot() {
    nvs_handle_t h; uint8_t rot = 0xFF, flip = 0;
    if (nvs_open("tesla_cfg", NVS_READONLY, &h) == ESP_OK) {
        if (nvs_get_u8(h, "disp_rot", &rot) != ESP_OK) rot = 0xFF;   // absent → migrate/default
        nvs_get_u8(h, "disp_flip", &flip);                          // legacy key (ignored if disp_rot present)
        nvs_close(h);
    }
    if (rot <= 3) return rot;
    return flip ? 3 : 1;                                             // migrate old flip; default landscape
}
static void save_disp_rot(int rot) {
    nvs_handle_t h;
    if (nvs_open("tesla_cfg", NVS_READWRITE, &h) == ESP_OK) {
        nvs_set_u8(h, "disp_rot", (uint8_t)(rot & 3));
        nvs_commit(h);
        nvs_close(h);
    }
}
// Apply rotation index r: swap the framebuffer geometry (W/H) + RAM offsets and re-send MADCTL.
// The framebuffer is NOT reallocated (both orientations are FB_PX px). Called only from the
// display task (which owns the SPI bus) and once at init, so re-sending MADCTL here is safe.
static void apply_rotation(int r) {
    s_rot = r & 3;
    const RotDef& d = ROTS[s_rot];
    s_cfg.madctl = d.madctl;
    s_cfg.x_off  = d.x_off;
    s_cfg.y_off  = d.y_off;
    W = d.w;
    H = d.h;
    wr_cmd(0x36); wr_data(s_cfg.madctl);           // MADCTL
}
// One BOOT tap → 90° step. `+1` cycles one way; use `+3` (== −1) for the opposite direction.
static void rotate_90(void) {
    apply_rotation((s_rot + 1) & 3);
    save_disp_rot(s_rot);
    ESP_LOGI(TAG, "display rotated → index %d (MADCTL 0x%02X, %dx%d)", s_rot, s_cfg.madctl, W, H);
}

static void display_task_impl(void* arg) {
    VehicleController& v = *static_cast<VehicleController*>(arg);

    // BOOT button (BOOT_BTN: C5 IO28 / S3 IO0): input with pull-up; a press pulls it LOW.
    gpio_config_t btn = {};
    btn.pin_bit_mask = 1ULL << BOOT_BTN;
    btn.mode         = GPIO_MODE_INPUT;
    btn.pull_up_en   = GPIO_PULLUP_ENABLE;
    gpio_config(&btn);
    bool btn_prev = true;                 // released (HIGH)

    int tick = 0;
    bool paired = v.has_session();        // has_session() hits NVS — sample at ~1 Hz
    for (;;) {
        bool animating = render_frame(v, tick, paired);
        flush();
        ++tick;
        if (animating) { if (tick % 8 == 0) paired = v.has_session(); }  // ~1 Hz
        else           { paired = v.has_session(); }                     // 1 Hz slow tick

        // Wait for the next frame (120 ms animating / 1000 ms static) while polling the
        // BOOT button every 40 ms so a tap is never missed — a HIGH→LOW edge = press.
        int frame_ms = animating ? 120 : 1000;
        for (int slept = 0; slept < frame_ms; slept += 40) {
            vTaskDelay(pdMS_TO_TICKS(40));
            bool lvl = gpio_get_level((gpio_num_t)BOOT_BTN);
            bool pressed = btn_prev && !lvl;
            btn_prev = lvl;
            if (pressed) {
                rotate_90();
                // Break the wait so the outer loop re-composes + flushes for the new orientation
                // NOW. rotate_90() only re-sends MADCTL; without an immediate redraw the panel keeps
                // scanning the OLD GRAM reinterpreted under the new MADCTL — a stale rotated frame
                // for up to a full frame_ms (~1 s in the static battery view).
                break;
            }
        }
    }
}

static void display_task(void* arg) {
    for (;;) {
        try {
            display_task_impl(arg);
        } catch (const std::exception& e) {
            ESP_LOGE(TAG, "display task threw (%s); restarting renderer state", e.what());
        } catch (...) {
            ESP_LOGE(TAG, "display task threw (unknown); restarting renderer state");
        }
        vTaskDelay(pdMS_TO_TICKS(1000));
    }
}

#if CONFIG_IDF_TARGET_ESP32S3
// Detect the LilyGo T-Dongle-S3 by its TF-card socket's external SD pull-ups. The single
// esp32s3 image also runs on a generic ESP32-S3 (no panel); the ST7735 itself can't be
// probed (its SDA is write-only — no MISO), but the dongle wires the S3's SDMMC bus (CMD=16,
// D0-D3=14/17/21/18, CLK=12) with EXTERNAL pull-ups, while a bare ESP32-S3 leaves those
// GPIOs floating. Read each with an internal pull-DOWN: still HIGH ⇒ an external pull-up
// holds it ⇒ the dongle. A majority vote (≥4/6) tolerates a stray. HW-verified: 6/6 HIGH on
// a T-Dongle-S3, 0/6 on a generic ESP32-S3. These GPIOs are otherwise unused; each is reset
// and left floating after the probe.
static bool is_t_dongle_s3() {
    static const gpio_num_t sd_pins[] = { GPIO_NUM_16, GPIO_NUM_14, GPIO_NUM_17,
                                          GPIO_NUM_21, GPIO_NUM_18, GPIO_NUM_12 };
    int pulled = 0;
    for (gpio_num_t p : sd_pins) {
        gpio_reset_pin(p);
        gpio_set_direction(p, GPIO_MODE_INPUT);
        gpio_set_pull_mode(p, GPIO_PULLDOWN_ONLY);
        esp_rom_delay_us(1000);            // let the weak internal pull settle
        if (gpio_get_level(p)) ++pulled;
        gpio_set_pull_mode(p, GPIO_FLOATING);
    }
    ESP_LOGI(TAG, "T-Dongle-S3 SD pull-up probe: %d/6 held HIGH", pulled);
    return pulled >= 4;
}
#endif

void display_start(VehicleController& vehicle) {
#if CONFIG_IDF_TARGET_ESP32S3
    // The single esp32s3 OTA image serves BOTH the LilyGo T-Dongle-S3 (onboard panel) and a
    // generic ESP32-S3 (no panel). Auto-detect the dongle BEFORE touching any GPIO/heap so a
    // generic board stays a complete no-op (no framebuffer alloc, no SPI, no backlight driven).
    if (!is_t_dongle_s3()) { ESP_LOGI(TAG, "no T-Dongle-S3 detected — display disabled"); return; }
#endif
    // Panel wiring — pins from Kconfig (per-board sdkconfig.defaults.*). The 0.96" GREENTAB
    // panel is mounted portrait (80x160); the MADCTL / col-row offsets / framebuffer geometry
    // come from the saved BOOT-rotation index (ROTS, default 1 = LANDSCAPE 160x80, MADCTL 0xA8
    // MY|MV|BGR with offsets 1/26). Backlight is ACTIVE-LOW — identical on the T-Dongle-C5 and
    // T-Dongle-S3 (only pins/SPI-clock/BOOT-button GPIO differ; C5 BL GPIO0, S3 BL GPIO38).
    s_cfg = DisplayConfig{
        .mosi = CONFIG_TESLA_DISPLAY_SPI_MOSI, .sck = CONFIG_TESLA_DISPLAY_SPI_SCK,
        .cs = CONFIG_TESLA_DISPLAY_CS, .dc = CONFIG_TESLA_DISPLAY_DC,
        .rst = CONFIG_TESLA_DISPLAY_RST, .bl = CONFIG_TESLA_DISPLAY_BL,
        .bl_active_low = true, .x_off = 1, .y_off = 26, .madctl = 0xA8,
    };
    // Restore the saved rotation (migrates the legacy disp_flip). Populate s_cfg + W/H directly
    // here — panel_init() sends this MADCTL; the SPI bus isn't up yet, so don't re-send it.
    s_rot = load_disp_rot();
    const RotDef& d0 = ROTS[s_rot];
    s_cfg.madctl = d0.madctl; s_cfg.x_off = d0.x_off; s_cfg.y_off = d0.y_off;
    W = d0.w; H = d0.h;

    // Framebuffer: PSRAM first. On the C5 (8 MB in-package PSRAM) that always wins and there
    // is deliberately NO fallback — grabbing 25 KB of its scarce contiguous internal SRAM
    // could OOM-reboot that memory-tight board (and a reboot loop keeps a parked car from ever
    // sleeping). The T-Dongle-S3 build has no PSRAM, so it falls back to internal SRAM (~25 KB,
    // allocated once here at boot before WiFi/BLE fragment the heap — the proven pre-#98 path).
    s_fb = (uint16_t*)heap_caps_malloc(FB_PX * sizeof(uint16_t), MALLOC_CAP_SPIRAM);
#if !CONFIG_IDF_TARGET_ESP32C5
    if (!s_fb) s_fb = (uint16_t*)heap_caps_malloc(FB_PX * sizeof(uint16_t), MALLOC_CAP_8BIT);
#endif
    if (!s_fb) { ESP_LOGE(TAG, "no memory for framebuffer — display disabled"); return; }

    gpio_config_t io = {};
    io.mode = GPIO_MODE_OUTPUT;
    io.pin_bit_mask = (1ULL << s_cfg.dc) | (1ULL << s_cfg.rst) | (1ULL << s_cfg.bl);
    gpio_config(&io);
    gpio_set_level((gpio_num_t)s_cfg.bl, BL_ON());   // backlight on (honours polarity)

    spi_bus_config_t bus = {};
    bus.mosi_io_num   = s_cfg.mosi;
    bus.miso_io_num   = -1;
    bus.sclk_io_num   = s_cfg.sck;
    bus.quadwp_io_num = -1;
    bus.quadhd_io_num = -1;
    bus.max_transfer_sz = 160 * 2 + 8;   // one row at the widest (landscape) orientation
    if (spi_bus_initialize(SPI2_HOST, &bus, SPI_DMA_CH_AUTO) != ESP_OK) {
        ESP_LOGE(TAG, "spi_bus_initialize failed — display disabled");
        heap_caps_free(s_fb); s_fb = nullptr; return;
    }
    spi_device_interface_config_t dev = {};
    dev.clock_speed_hz = SPI_CLOCK_HZ;       // 20 MHz on the C5 (LilyGo's tested rate), 40 MHz on the S3
    dev.mode           = 0;
    dev.spics_io_num   = s_cfg.cs;
    dev.queue_size     = 7;
    if (spi_bus_add_device(SPI2_HOST, &dev, &s_spi) != ESP_OK) {
        ESP_LOGE(TAG, "spi_bus_add_device failed — display disabled");
        spi_bus_free(SPI2_HOST); heap_caps_free(s_fb); s_fb = nullptr; return;
    }

    panel_init();
    ESP_LOGI(TAG, "ST7735 %dx%d (%s, rot %d) up on SPI2 (MOSI%d SCK%d CS%d DC%d, MADCTL 0x%02X)",
             W, H, ROTS[s_rot].portrait ? "portrait" : "landscape", s_rot,
             s_cfg.mosi, s_cfg.sck, s_cfg.cs, s_cfg.dc, s_cfg.madctl);

    // 6 KB stack: soft-float gradient lerp + snprintf framing — 4 KB would be tight.
    if (xTaskCreate(display_task, "display", 6144, &vehicle, tk::kPrioDisplay, nullptr) != pdPASS) {
        ESP_LOGE(TAG, "display task create failed — display disabled");
        spi_bus_remove_device(s_spi); s_spi = nullptr;
        spi_bus_free(SPI2_HOST); heap_caps_free(s_fb); s_fb = nullptr;
    }
}

#else  // !CONFIG_TESLA_DISPLAY_ENABLED

void display_start(VehicleController&) {}   // no panel on this board build

#endif
